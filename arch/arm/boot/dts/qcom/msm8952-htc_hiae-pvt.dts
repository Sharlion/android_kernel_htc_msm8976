/*
 * Copyright (c) 2015, The Linux Foundation. All rights reserved.
 *
 * This program is free software; you can redistribute it and/or modify
 * it under the terms of the GNU General Public License version 2 and
 * only version 2 as published by the Free Software Foundation.
 *
 * This program is distributed in the hope that it will be useful,
 * but WITHOUT ANY WARRANTY; without even the implied warranty of
 * MERCHANTABILITY or FITNESS FOR A PARTICULAR PURPOSE.  See the
 * GNU General Public License for more details.
 */

/dts-v1/;

#include "msm8952-htc_hiae.dtsi"
#include "msm8952-camera-sensor-hiaaero-xd.dtsi"

/ {
	model = "Qualcomm Technologies, Inc. MSM8952 HIAE PVT";
	qcom,msm-id = <396 0x10001>, <397 0x10001>, <398 0x10001>,
	              <399 0x10001>, <400 0x10001>;
	qcom,board-id= <0x80 0>;
};
&soc {
	usb_otg: usb@78db000 {
	qcom,hsusb-otg-phy-init-seq = <0x44 0x80 0x7D 0x81 0x24 0x82 0x13 0x83 0xffffffff>;
	};
};
