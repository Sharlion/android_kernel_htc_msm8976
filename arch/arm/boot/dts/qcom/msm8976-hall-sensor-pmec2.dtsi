&soc {
	hall_ak8789 {
		compatible = "hall_sensor,ak8789";
		hall,att_used = <2>;
		hall,att_gpio = <&msm_gpio 12 0>;
		hall,att_gpio_s = <&msm_gpio 13 0>;
		pinctrl-names = "default";
		pinctrl-0 = <&hall_pinctrl_active>;
		hall,SW_timer_debounce_n = <75>;
	};
};
