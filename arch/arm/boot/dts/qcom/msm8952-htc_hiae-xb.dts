/*
 * Copyright (c) 2015, The Linux Foundation. All rights reserved.
 *
 * This program is free software; you can redistribute it and/or modify
 * it under the terms of the GNU General Public License version 2 and
 * only version 2 as published by the Free Software Foundation.
 *
 * This program is distributed in the hope that it will be useful,
 * but WITHOUT ANY WARRANTY; without even the implied warranty of
 * MERCHANTABILITY or FITNESS FOR A PARTICULAR PURPOSE.  See the
 * GNU General Public License for more details.
 */

/dts-v1/;

#include "msm8952-htc_hiae.dtsi"
#include "msm8952-camera-sensor-hiaaero.dtsi"

/ {
	model = "Qualcomm Technologies, Inc. MSM8952 HIAE XB";
	qcom,msm-id = <396 0x10000>, <397 0x10000>, <398 0x10000>,
	              <399 0x10000>, <400 0x10000>,
                      <396 0x10001>, <397 0x10001>, <398 0x10001>,
                      <399 0x10001>, <400 0x10001>;
	qcom,board-id= <1 0>;
};
