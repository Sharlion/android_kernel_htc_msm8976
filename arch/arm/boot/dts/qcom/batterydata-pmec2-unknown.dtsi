/* Copyright (c) 2013-2014, The Linux Foundation. All rights reserved.
 *
 * This program is free software; you can redistribute it and/or modify
 * it under the terms of the GNU General Public License version 2 and
 * only version 2 as published by the Free Software Foundation.
 *
 * This program is distributed in the hope that it will be useful,
 * but WITHOUT ANY WARRANTY; without even the implied warranty of
 * MERCHANTABILITY or FITNESS FOR A PARTICULAR PURPOSE.  See the
 * GNU General Public License for more details.
 */

qcom,pmec2-id_unknown-batterydata {
	qcom,max-voltage-uv = <4200000>;
	qcom,nom-batt-capacity-mah = <2150>;
	qcom,batt-id-kohm = <99>;
	qcom,battery-beta = <4160>;
	qcom,battery-type = "pmec2_id_unknown";
	qcom,chg-rslow-comp-c1 = <3625672>;
	qcom,chg-rslow-comp-c2 = <5649333>;
	qcom,chg-rs-to-rslow = <1349687>;
	qcom,chg-rslow-comp-thr = <0xAE>;
	qcom,checksum = <0x869B>;
	qcom,gui-version = "PMI8950GUI - 2.0.0.3";

	qcom,v-cutoff-uv = <3400000>;
	qcom,chg-term-ua = <100000>;
	htc,batt_id = <255>;
	htc,id_raw_min = <(-1)>;
	htc,id_raw_max = <(-1)>;

	qcom,fg-profile-data = [
		E1 83 CF 7C
		0D 81 19 77
		65 83 5E 74
		73 89 85 94
		52 82 FB 93
		0E B5 4C C0
		52 17 EE 83
		D0 7C EB 80
		AB 76 5A 83
		80 60 67 81
		E0 8D 50 82
		AC 99 FE BC
		F3 C9 54 0D
		A5 08 77 5B
		14 70 B8 FE
		1E 3D 61 37
		00 00 00 00
		8B 44 39 32
		3E 3D 00 00
		00 00 00 00
		00 00 00 00
		59 70 DB 6B
		46 6A 88 81
		72 6E 86 60
		B3 60 80 7A
		C2 6C 82 59
		04 8D 34 C8
		0C C6 69 44
		6C A0 71 0C
		28 00 FF 36
		F0 11 30 03
		00 00 00 0C
	];
};
